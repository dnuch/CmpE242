## kernel_modules/blinker_242/Kconfig
```kconfig
menu "CmpE 242 Kernels"

config hello_world
	tristate "hello world!"
	help
		sample hello world module!

endmenu
```

## kernel_modules/stepper_242/Kconfig
```kconfig
menu "CmpE 242 Kernels"

config STEPPER_242
	tristate "stepper 242"
	help
		Stepper motor LKM for GPIO/PWM0

endmenu
```
